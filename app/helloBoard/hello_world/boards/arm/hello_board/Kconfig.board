## app/helloBoard/hello_world/boards/arm/hello_board/Kconfig.board
```kconfig
# nRF9160 DK NRF9160 board configuration

# Copyright (c) 2018-2020 Nordic Semiconductor ASA
# SPDX-License-Identifier: Apache-2.0

if SOC_NRF9160_SICA

config BOARD_HELLO_BOARD
	bool "Hello-Board"

config BOARD_HELLO_BOARDNS
	bool "Hello-Board non-secure"

endif # SOC_NRF9160_SICA
```

## app/helloBoard/hello_world/boards/arm/nrf52833qdaa_nrf52833/Kconfig.board
```kconfig
# nRF52833 DK NRF52833 board configuration

# Copyright (c) 2019 Nordic Semiconductor ASA
# SPDX-License-Identifier: Apache-2.0

config BOARD_NRF52833QDAA_NRF52833
	bool "NRF52833 QDAA NRF52833"
	depends on SOC_NRF52833_QIAA
```

## app/helloBoard/hello_world/boards/arm/nrf52840dk_test/Kconfig.defconfig
```kconfig
# nRF52840 DK NRF52840 board configuration

# Copyright (c) 2016 Nordic Semiconductor ASA
# SPDX-License-Identifier: Apache-2.0

if BOARD_NRF52840DK_TEST

config BOARD
	default "NRF52840DK_TEST"

if USB

config USB_NRFX
	default y

config USB_DEVICE_STACK
	default y

endif # USB

config BT_CTLR
	default BT

endif # BOARD_NRF52840DK_TEST
```

## app/helloBoard/hello_world/boards/arm/test_board/Kconfig.board
```kconfig
# test_board NRF9160 board configuration

# Copyright (c) 2018-2020 Nordic Semiconductor ASA
# SPDX-License-Identifier: Apache-2.0

if SOC_NRF9160_SICA

config BOARD_TEST_BOARD
	bool "test_board"

config BOARD_TEST_BOARDNS
	bool "test_board non-secure"

endif # SOC_NRF9160_SICA
```

## driver/spi_flash/boards/nrf52840dk_nrf52811.conf
```kconfig
#
# Copyright (c) 2019 Peter Bigot Consulting, LLC
# Copyright (c) 2019 Nordic Semiconductor ASA
#
# SPDX-License-Identifier: Apache-2.0
#

CONFIG_SPI_NOR=y
```
