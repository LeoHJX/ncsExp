## prj.conf
```kconfig
CONFIG_SERIAL=n
CONFIG_UART_CONSOLE=n
###### General config
CONFIG_NEWLIB_LIBC=y
CONFIG_NEWLIB_LIBC_FLOAT_PRINTF=y
CONFIG_NCS_SAMPLES_DEFAULTS=y


###### Network
CONFIG_NETWORKING=y
CONFIG_NET_NATIVE=n
CONFIG_NET_SOCKETS=y
CONFIG_NET_SOCKETS_OFFLOAD=y

####### LTE link control
CONFIG_LTE_LINK_CONTROL=y
CONFIG_LTE_AUTO_INIT_AND_CONNECT=n

###### BSD library
CONFIG_BSD_LIBRARY=y

###### Heap and stacks
CONFIG_HEAP_MEM_POOL_SIZE=1024
CONFIG_MAIN_STACK_SIZE=2048
CONFIG_SYSTEM_WORKQUEUE_STACK_SIZE=2048
```

## src/main.c
```c
/*
 * Copyright (c) 2012-2014 Wind River Systems, Inc.
 *
 * SPDX-License-Identifier: Apache-2.0
 */

#include <zephyr.h>
#include <sys/printk.h>
#include <modem/lte_lc.h>
#include <power/power.h>
#include <hal/nrf_regulators.h>

void disable_uart() // disable UART to measure current.
{
	NRF_UARTE0->ENABLE = 0;
	NRF_UARTE1->ENABLE = 0;
}
void main(void)
{
	printk("Hello World! %s\n", CONFIG_BOARD);

	lte_lc_power_off();
	k_sleep(K_MSEC(1200));
	disable_uart();
	k_sleep(K_MSEC(100));
#if 0 /*   App core off option */
	nrf_regulators_system_off(NRF_REGULATORS_NS);
#else /* idle otherwise */

	/* then app core idle   */
	k_cpu_idle();
	for (;;) {
		k_cpu_idle();
	}
#endif
}
```
