## Kconfig
```
#
# Copyright (c) 2020 Nordic Semiconductor ASA
#
# SPDX-License-Identifier: LicenseRef-BSD-5-Clause-Nordic
#

menu "UDP Sample Settings"

config UDP_DATA_UPLOAD_SIZE_BYTES
	int "Number of bytes transmitted to the server"
	default 10

config UDP_DATA_UPLOAD_FREQUENCY_SECONDS
	int "How often data is transmitted to the server"
	default 60

config UDP_SERVER_ADDRESS_STATIC
	string "UDP server IP address"
	default "8.8.8.8"

config UDP_SERVER_PORT
	int "UDP server port number"
	default "2469"

config UDP_PSM_ENABLE
	bool "Enable LTE Power Saving Mode"
	default y

config UDP_EDRX_ENABLE
	bool "Enable LTE enhanced Discontinuous Reception"

config UDP_RAI_ENABLE
	bool "Enable LTE Release Assistance Indication"

config RAI_ENABLE_AFTER_PACKET_SEND
	bool "Enable LTE Release Assistance Indication"	
	default n

config RECEIVE_UDP_PACKETS
	bool "Receve UDP return packets if enabled."
	default n

config UDP_RECV_TIMEOUT_SECONDS
	int "timeout for UDP receiving"
	default 2

endmenu

module = UDP
module-str = UDP sample
source "${ZEPHYR_BASE}/subsys/logging/Kconfig.template.log_config"

menu "Zephyr Kernel"
source "Kconfig.zephyr"
endmenu
```

## prj.conf
```kconfig
#
# Copyright (c) 2020 Nordic Semiconductor ASA
#
# SPDX-License-Identifier: LicenseRef-BSD-5-Clause-Nordic
#

###### UDP settings

CONFIG_UDP_DATA_UPLOAD_SIZE_BYTES=100
CONFIG_UDP_DATA_UPLOAD_FREQUENCY_SECONDS=30
#CONFIG_UDP_SERVER_ADDRESS_STATIC="8.8.8.8"
#CONFIG_UDP_SERVER_PORT=2469
CONFIG_UDP_SERVER_ADDRESS_STATIC="202.169.100.197"
CONFIG_UDP_SERVER_PORT=65003


CONFIG_RECEIVE_UDP_PACKETS=y

CONFIG_UDP_RECV_TIMEOUT_SECONDS=4



###### General config
CONFIG_NEWLIB_LIBC=y
CONFIG_NEWLIB_LIBC_FLOAT_PRINTF=y
CONFIG_NCS_SAMPLES_DEFAULTS=y


###### Network
CONFIG_NETWORKING=y
CONFIG_NET_NATIVE=n
CONFIG_NET_SOCKETS=y
CONFIG_NET_SOCKETS_OFFLOAD=y

####### LTE link control
CONFIG_LTE_LINK_CONTROL=y
CONFIG_LTE_AUTO_INIT_AND_CONNECT=n

###### BSD library
CONFIG_BSD_LIBRARY=y

###### Heap and stacks
CONFIG_HEAP_MEM_POOL_SIZE=1024
CONFIG_MAIN_STACK_SIZE=4096
CONFIG_SYSTEM_WORKQUEUE_STACK_SIZE=2048

###### LTE RAT, (GPS etc. only 1 at a time)
###### Network Mode / LTE category
#CONFIG_LTE_NETWORK_MODE_LTE_M=y
#CONFIG_LTE_NETWORK_MODE_LTE_M_GPS=y
CONFIG_LTE_NETWORK_MODE_NBIOT=y
#CONFIG_LTE_NETWORK_MODE_NBIOT_GPS=y

###### PSM
CONFIG_UDP_PSM_ENABLE=y
CONFIG_LTE_PSM_REQ_RPTAU="00111000"
######default Telstra TAU: 00111000 -> 24 hours, if the number too small, could get rejected which means the timer not activated (PSM for ever ^_^)
CONFIG_LTE_PSM_REQ_RAT="00000000"

###### eDRX CONFIG_LTE_EDRX_REQ
CONFIG_UDP_EDRX_ENABLE=n
CONFIG_LTE_EDRX_REQ=n
CONFIG_LTE_EDRX_REQ_VALUE="1001"
CONFIG_LTE_EDRX_REQ_VALUE="1001"
######1001 ; 163.84 seconds.

###### RAI (release assistant indication)
CONFIG_UDP_RAI_ENABLE=n
CONFIG_LTE_RAI_REQ_VALUE="4"

CONFIG_RAI_ENABLE_AFTER_PACKET_SEND=y
######BAND Lock, comment out if not needed. 

CONFIG_LTE_LOCK_BANDS=y
###### Bands 3, 8, 28 ;#enable B3, 8, 28, good for ANZ.
#CONFIG_LTE_LOCK_BAND_MASK="1000000000000000000010000100"
######band 8
#CONFIG_LTE_LOCK_BAND_MASK="10000000"
######band 28
CONFIG_LTE_LOCK_BAND_MASK="1000000000000000000000000000"



####### Enable logging output for debugging. 
####### make sure enable SERIAL for output 
#CONFIG_SERIAL=y
####### for AT commands.  comment out to default info
#CONFIG_AT_CMD_LOG_LEVEL_DBG=y
#
####### link control comment out to default info
#CONFIG_LTE_LINK_CONTROL_LOG_LEVEL_DBG=y
#
####### for urc notification; comment out to default info
#CONFIG_AT_NOTIF_LOG_LEVEL_DBG=y

######RTT for debugging
#CONFIG_LOG_PRINTK=y
## Segger RTT
#CONFIG_USE_SEGGER_RTT=y
#CONFIG_RTT_CONSOLE=y
#CONFIG_UART_CONSOLE=n
#CONFIG_LOG_BACKEND_RTT=y
#CONFIG_LOG_BACKEND_UART=n

###### Disable logging output for debugging. 
###### make sure enable SERIAL for output 
CONFIG_SERIAL=n
###### for AT commands.  comment out to default info
CONFIG_AT_CMD_LOG_LEVEL_DBG=n

###### link control comment out to default info
CONFIG_LTE_LINK_CONTROL_LOG_LEVEL_DBG=n

###### for urc notification; comment out to default info
CONFIG_AT_NOTIF_LOG_LEVEL_DBG=n
```

## src/main.c
```c
/*
 * Copyright (c) 2020 Nordic Semiconductor ASA
 *
 * SPDX-License-Identifier: LicenseRef-BSD-5-Clause-Nordic
 */

#include <zephyr.h>
#include <stdio.h>
#include <nrf_socket.h>
#include <modem/lte_lc.h>
#include <net/socket.h>

#define UDP_IP_HEADER_SIZE 28

static int client_fd;
static struct sockaddr_storage host_addr;
static struct k_delayed_work server_transmission_work;

K_SEM_DEFINE(lte_connected, 0, 1);

static void server_transmission_work_fn(struct k_work *work)
{
	int err;
    static uint32_t cnt;

	char buffer[CONFIG_UDP_DATA_UPLOAD_SIZE_BYTES] = {"#"};

    memset(buffer, '#', CONFIG_UDP_DATA_UPLOAD_SIZE_BYTES);
#if defined(CONFIG_RAI_ENABLE_AFTER_PACKET_SEND)	
	err = lte_lc_rai_req(false);
	if (err) {
		printk("lte_lc_rai_req, error: %d\n", err);
	}
	k_sleep(K_MSEC(100));
#endif	/* #if defined(CONFIG_RAI_ENABLE_AFTER_PACKET_SEND)  */
#if defined(CONFIG_RECEIVE_UDP_PACKETS)
    cnt=0;
    sprintf(buffer, "pkg:%d ", cnt);  /* fixed packets for server to check and reply.  */
#else
    sprintf(buffer, "pkg:%d ", cnt++);
#endif

	printk("Transmitting UDP/IP payload of %d bytes to the ",
	       CONFIG_UDP_DATA_UPLOAD_SIZE_BYTES + UDP_IP_HEADER_SIZE);
	printk("IP address %s, port number %d\n",
	       CONFIG_UDP_SERVER_ADDRESS_STATIC, CONFIG_UDP_SERVER_PORT);

	err = send(client_fd, buffer, sizeof(buffer), 0);
	if (err < 0) {
		printk("Failed to transmit UDP packet, %d\n", errno);
		return;
	}
#if defined(CONFIG_RECEIVE_UDP_PACKETS)

    memset(buffer, 0, sizeof(buffer));

	err = recv(client_fd, buffer, CONFIG_UDP_DATA_UPLOAD_SIZE_BYTES, 0);
	if (err < 0) {
		printk("Failed to receive UDP packet, %d\n", errno);
        goto workerror;
		/* return; */ /* do not return */
	}  
    printk("recv: %s\n", buffer);
workerror:
#endif
#if defined(CONFIG_RAI_ENABLE_AFTER_PACKET_SEND)
	/** Release Assistance Indication  */
	err = lte_lc_rai_req(true);
	if (err) {
		printk("lte_lc_rai_req, error: %d\n", err);
	}
	k_sleep(K_MSEC(100));
	err = send(client_fd, buffer, 2, 0);
	if (err < 0) {
		printk("Failed to transmit UDP packet, %d\n", errno);
		return;
	}	
#endif
	k_delayed_work_submit(
		&server_transmission_work,
		K_SECONDS(CONFIG_UDP_DATA_UPLOAD_FREQUENCY_SECONDS));
}

static void work_init(void)
{
	k_delayed_work_init(&server_transmission_work,
			    server_transmission_work_fn);
}

#if defined(CONFIG_BSD_LIBRARY)
static void lte_handler(const struct lte_lc_evt *const evt)
{
	switch (evt->type) {
	case LTE_LC_EVT_NW_REG_STATUS:
		if ((evt->nw_reg_status != LTE_LC_NW_REG_REGISTERED_HOME) &&
		    (evt->nw_reg_status != LTE_LC_NW_REG_REGISTERED_ROAMING)) {
			break;
		}

		printk("Network registration status: %s\n",
		       evt->nw_reg_status == LTE_LC_NW_REG_REGISTERED_HOME ?
			       "Connected - home network" :
			       "Connected - roaming\n");
		k_sem_give(&lte_connected);
		break;
	case LTE_LC_EVT_PSM_UPDATE:
		printk("PSM parameter update: TAU: %d, Active time: %d\n",
		       evt->psm_cfg.tau, evt->psm_cfg.active_time);
		break;
	case LTE_LC_EVT_EDRX_UPDATE: {
		char log_buf[60];
		ssize_t len;

		len = snprintf(log_buf, sizeof(log_buf),
			       "eDRX parameter update: eDRX: %f, PTW: %f\n",
			       evt->edrx_cfg.edrx, evt->edrx_cfg.ptw);
		if (len > 0) {
			printk("%s\n", log_buf);
		}
		break;
	}
	case LTE_LC_EVT_RRC_UPDATE:
		printk("RRC mode: %s\n",
		       evt->rrc_mode == LTE_LC_RRC_MODE_CONNECTED ?
			       "Connected" :
			       "Idle\n");
		break;
	case LTE_LC_EVT_CELL_UPDATE:
		printk("LTE cell changed: Cell ID: %d, Tracking area: %d\n",
		       evt->cell.id, evt->cell.tac);
		break;
	default:
		break;
	}
}

static int configure_low_power(void)
{
	int err;

#if defined(CONFIG_UDP_PSM_ENABLE)
	/** Power Saving Mode */
	err = lte_lc_psm_req(true);
	if (err) {
		printk("lte_lc_psm_req, error: %d\n", err);
	}
#else
	err = lte_lc_psm_req(false);
	if (err) {
		printk("lte_lc_psm_req, error: %d\n", err);
	}
#endif

#if defined(CONFIG_UDP_EDRX_ENABLE)
	/** enhanced Discontinuous Reception */
	err = lte_lc_edrx_req(true);
	if (err) {
		printk("lte_lc_edrx_req, error: %d\n", err);
	}
#else
	err = lte_lc_edrx_req(false);
	if (err) {
		printk("lte_lc_edrx_req, error: %d\n", err);
	}
#endif

#if defined(CONFIG_UDP_RAI_ENABLE)
	/** Release Assistance Indication  */
	err = lte_lc_rai_req(true);
	if (err) {
		printk("lte_lc_rai_req, error: %d\n", err);
	}
#endif

	return err;
}

/*   new modem_configure with init and connect async, error on RAI request if default setup is CATM1 network. */

int lte_lc_init_and_connect_async_new(lte_lc_evt_handler_t handler)
{
	int err;

	err = lte_lc_init();
	if (err) {
		return err;
	}
	err = configure_low_power(); /* setup low power before connect */
	if (err) {
		printk("Unable to set low power configuration, error: %d\n",
		       err);
	}
	return lte_lc_connect_async(handler);
}

static void modem_configure(void)
{
	int err;

	if (IS_ENABLED(CONFIG_LTE_AUTO_INIT_AND_CONNECT)) {
		/* Do nothing, modem is already configured and LTE connected. */
	} else {
		err = lte_lc_init_and_connect_async_new(lte_handler);
		if (err) {
			printk("Modem configuration, error: %d\n", err);
			return;
		}
	}
}
#endif

static void server_disconnect(void)
{
	(void)close(client_fd);
}

static int server_init(void)
{
	struct sockaddr_in *server4 = ((struct sockaddr_in *)&host_addr);

	server4->sin_family = AF_INET;
	server4->sin_port = htons(CONFIG_UDP_SERVER_PORT);

	inet_pton(AF_INET, CONFIG_UDP_SERVER_ADDRESS_STATIC,
		  &server4->sin_addr);

	return 0;
}

static int server_connect(void)
{
	int err;

	client_fd = socket(AF_INET, SOCK_DGRAM, IPPROTO_UDP);
	if (client_fd < 0) {
		printk("Failed to create UDP socket: %d\n", errno);
		goto error;
	}
#if defined(CONFIG_UDP_RECV_TIMEOUT_SECONDS)
	struct timeval timeout = {
		.tv_sec = CONFIG_UDP_RECV_TIMEOUT_SECONDS,
		.tv_usec = 0,
	};

	err = setsockopt(client_fd,
			 NRF_SOL_SOCKET,
			 NRF_SO_RCVTIMEO,
			 &timeout,
			 sizeof(timeout));
	if (err) {
		printk("Failed to setup socket timeout, errno %d\n", errno);
		/* do not return */ /* return -1; */
	}
#endif
	err = connect(client_fd, (struct sockaddr *)&host_addr,
		      sizeof(struct sockaddr_in));
	if (err < 0) {
		printk("Connect failed : %d\n", errno);
		goto error;
	}

	return 0;

error:
	server_disconnect();

	return err;
}

void disable_uart() // disable UART to measure current.
{
	NRF_UARTE0->ENABLE = 0;
	NRF_UARTE1->ENABLE = 0;
}

void main(void)
{
	int err;

	printk("UDP sample has started\n");

	work_init();

#if defined(CONFIG_BSD_LIBRARY)

	modem_configure(); /* move modem config before low power config, RAI won't work if the LTE network mode by default not NBIoT  */

	k_sem_take(&lte_connected, K_FOREVER);
#endif

	err = server_init();
	if (err) {
		printk("Not able to initialize UDP server connection\n");
		return;
	}

	err = server_connect();
	if (err) {
		printk("Not able to connect to UDP server\n");
		return;
	}

	k_delayed_work_submit(&server_transmission_work, K_NO_WAIT);
	/* disable UART here to save power */

	//disable_uart();
}
```
