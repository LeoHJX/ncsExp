## Kconfig
```
#
# Copyright (c) 2020 Nordic Semiconductor ASA
#
# SPDX-License-Identifier: LicenseRef-BSD-5-Clause-Nordic
#

menu "UDP Sample Settings"

config UDP_DATA_UPLOAD_SIZE_BYTES
	int "Number of bytes transmitted to the server"
	default 10

config UDP_DATA_UPLOAD_FREQUENCY_SECONDS
	int "How often data is transmitted to the server"
	default 60

config UDP_SERVER_ADDRESS_STATIC
	string "UDP server IP address"
	default "8.8.8.8"

config UDP_SERVER_PORT
	int "UDP server port number"
	default "2469"

config UDP_PSM_ENABLE
	bool "Enable LTE Power Saving Mode"
	default y

config UDP_EDRX_ENABLE
	bool "Enable LTE enhanced Discontinuous Reception"

config UDP_RAI_ENABLE
	bool "Enable LTE Release Assistance Indication"

config UDP_ON_OFF_ENABLE
	bool "Enable LTE ON OFF between data transmitting, no PSM, eDRX used if this enabled"
	default n

config USE_CFUN_0_OFF
	bool "Use CFUN=0 to switch off modem, otherwise CFUN=4 used"
	default n

config RECEIVE_UDP_PACKETS
	bool "Receve UDP return packets if enabled."
	default n

config TEST_USE_TCP
	bool "use TCP instead of UDP for testing."
	default n

config UDP_RECV_TIMEOUT_SECONDS
	int "timeout for UDP receiving"
	default 2

endmenu

module = UDP
module-str = UDP sample
source "${ZEPHYR_BASE}/subsys/logging/Kconfig.template.log_config"

menu "Zephyr Kernel"
source "Kconfig.zephyr"
endmenu
```

## prj.conf
```kconfig
#
# Copyright (c) 2020 Nordic Semiconductor ASA
#
# SPDX-License-Identifier: LicenseRef-BSD-5-Clause-Nordic
#

###### UDP settings

CONFIG_UDP_DATA_UPLOAD_SIZE_BYTES=1000
CONFIG_UDP_DATA_UPLOAD_FREQUENCY_SECONDS=30
CONFIG_UDP_SERVER_ADDRESS_STATIC="202.169.100.197"

#if TCP, port configurations need to be changed. 
CONFIG_TEST_USE_TCP=y  
#CONFIG_UDP_SERVER_PORT=65003
CONFIG_UDP_SERVER_PORT=65004

CONFIG_NET_TCP=y
CONFIG_NET_UDP=y

###### General config
CONFIG_NEWLIB_LIBC=y
CONFIG_NEWLIB_LIBC_FLOAT_PRINTF=y
CONFIG_NCS_SAMPLES_DEFAULTS=y


###### Network
CONFIG_NETWORKING=y
CONFIG_NET_NATIVE=n
CONFIG_NET_SOCKETS=y
CONFIG_NET_SOCKETS_OFFLOAD=y

####### LTE link control
CONFIG_LTE_LINK_CONTROL=y
CONFIG_LTE_AUTO_INIT_AND_CONNECT=n

###### BSD library
CONFIG_BSD_LIBRARY=y

###### Heap and stacks
CONFIG_HEAP_MEM_POOL_SIZE=4096
CONFIG_MAIN_STACK_SIZE=4096
CONFIG_SYSTEM_WORKQUEUE_STACK_SIZE=4096

###### LTE RAT, (GPS etc. only 1 at a time)
###### Network Mode / LTE category
CONFIG_LTE_NETWORK_MODE_LTE_M=y
#CONFIG_LTE_NETWORK_MODE_LTE_M_GPS=y
#CONFIG_LTE_NETWORK_MODE_NBIOT=y
#CONFIG_LTE_NETWORK_MODE_NBIOT_GPS=y

####### PSM
#CONFIG_UDP_PSM_ENABLE=y
#CONFIG_LTE_PSM_REQ_RPTAU="00111000"
#######default Telstra TAU: 00111000 -> 24 hours, if the number too small, could get rejected which means the timer not activated (PSM for ever ^_^)
#CONFIG_LTE_PSM_REQ_RAT="00000000"
#
####### eDRX CONFIG_LTE_EDRX_REQ
#CONFIG_UDP_EDRX_ENABLE=n
#CONFIG_LTE_EDRX_REQ=n
#CONFIG_LTE_EDRX_REQ_VALUE="1001"
#CONFIG_LTE_EDRX_REQ_VALUE="1001"
#######1001 ; 163.84 seconds.
#
####### RAI (release assistant indication)
#CONFIG_UDP_RAI_ENABLE=y
#CONFIG_LTE_RAI_REQ_VALUE="4"
#
#######BAND Lock, comment out if not needed. 

CONFIG_LTE_LOCK_BANDS=y
###### Bands 3, 8, 28 ;#enable B3, 8, 28, good for ANZ.
#CONFIG_LTE_LOCK_BAND_MASK="1000000000000000000010000100"
######band 8
#CONFIG_LTE_LOCK_BAND_MASK="10000000"
######band 28
CONFIG_LTE_LOCK_BAND_MASK="1000000000000000000000000000"

CONFIG_UDP_ON_OFF_ENABLE=y
CONFIG_USE_CFUN_0_OFF=n
CONFIG_RECEIVE_UDP_PACKETS=y
CONFIG_UDP_RECV_TIMEOUT_SECONDS=4

###### Enable logging output for debugging. 
###### make sure enable SERIAL for output 
CONFIG_SERIAL=n
###### for AT commands.  comment out to default info
#CONFIG_AT_CMD_LOG_LEVEL_DBG=y
#
####### link control comment out to default info
#CONFIG_LTE_LINK_CONTROL_LOG_LEVEL_DBG=y
#
####### for urc notification; comment out to default info
#CONFIG_AT_NOTIF_LOG_LEVEL_DBG=y


#####RTT for debugging

CONFIG_LOG_PRINTK=y
# Segger RTT
CONFIG_USE_SEGGER_RTT=y
CONFIG_RTT_CONSOLE=y
CONFIG_UART_CONSOLE=n
CONFIG_LOG_BACKEND_RTT=y
CONFIG_LOG_BACKEND_UART=n


###### Disable logging output for debugging. 
###### make sure enable SERIAL for output 
CONFIG_SERIAL=n
###### for AT commands.  comment out to default info
CONFIG_AT_CMD_LOG_LEVEL_DBG=n

###### link control comment out to default info
CONFIG_LTE_LINK_CONTROL_LOG_LEVEL_DBG=n

###### for urc notification; comment out to default info
CONFIG_AT_NOTIF_LOG_LEVEL_DBG=n
```

## src/main.c
```c
/*
 * Copyright (c) 2020 Nordic Semiconductor ASA
 *
 * SPDX-License-Identifier: LicenseRef-BSD-5-Clause-Nordic
 */

#include <zephyr.h>
#include <stdio.h>
#include <modem/lte_lc.h>
#include <nrf_socket.h>
#include <net/socket.h>
#include <modem/at_cmd.h>

#define UDP_IP_HEADER_SIZE 28

#define EACH_MAX_TCP_PACKET      1024

static int client_fd;
static struct sockaddr_storage host_addr;
static struct k_delayed_work server_transmission_work;

K_SEM_DEFINE(lte_connected, 0, 1);

#if defined(CONFIG_BSD_LIBRARY)
static void lte_handler(const struct lte_lc_evt *const evt)
{
	switch (evt->type) {
	case LTE_LC_EVT_NW_REG_STATUS:
		if ((evt->nw_reg_status != LTE_LC_NW_REG_REGISTERED_HOME) &&
		    (evt->nw_reg_status != LTE_LC_NW_REG_REGISTERED_ROAMING)) {
			break;
		}

		printk("Network registration status: %s\n",
		       evt->nw_reg_status == LTE_LC_NW_REG_REGISTERED_HOME ?
			       "Connected - home network" :
			       "Connected - roaming\n");
		k_sem_give(&lte_connected);
		break;
	case LTE_LC_EVT_PSM_UPDATE:
		printk("PSM parameter update: TAU: %d, Active time: %d\n",
		       evt->psm_cfg.tau, evt->psm_cfg.active_time);
		break;
	case LTE_LC_EVT_EDRX_UPDATE: {
		char log_buf[60];
		ssize_t len;

		len = snprintf(log_buf, sizeof(log_buf),
			       "eDRX parameter update: eDRX: %f, PTW: %f\n",
			       evt->edrx_cfg.edrx, evt->edrx_cfg.ptw);
		if (len > 0) {
			printk("%s\n", log_buf);
		}
		break;
	}
	case LTE_LC_EVT_RRC_UPDATE:
		printk("RRC mode: %s\n",
		       evt->rrc_mode == LTE_LC_RRC_MODE_CONNECTED ?
			       "Connected" :
			       "Idle\n");
		break;
	case LTE_LC_EVT_CELL_UPDATE:
		printk("LTE cell changed: Cell ID: %d, Tracking area: %d\n",
		       evt->cell.id, evt->cell.tac);
		break;
	default:
		break;
	}
}

/*   new modem_configure with init and connect async, error on RAI request if default setup is CATM1 network. */

int lte_lc_init_and_connect_async_new(lte_lc_evt_handler_t handler)
{
	int err;

	err = lte_lc_init();
	if (err) {
		return err;
	}

	return lte_lc_connect_async(handler);
}

#if defined(CONFIG_UDP_ON_OFF_ENABLE) 
int lte_lc_init_and_connect_async_onoff(void)
{
	int err;

	err = lte_lc_init();
	if (err) {
		return err;
	}
    return err;
	
}

int lte_lc_connect_async_onoff(lte_lc_evt_handler_t handler)
{
    return lte_lc_connect_async(handler);
}

static void modem_configure_onoff(void)
{
	int err;

	if (IS_ENABLED(CONFIG_LTE_AUTO_INIT_AND_CONNECT)) {
		/* Do nothing, modem is already configured and LTE connected. */
	} else {
		err = lte_lc_init_and_connect_async_onoff();
		if (err) {
			printk("Modem configuration, error: %d\n", err);
			return;
		}
	}
}

#endif /* #if defined(CONFIG_UDP_ON_OFF_ENABLE)   */
#endif /* #if defined(CONFIG_BSD_LIBRARY)  */

static void server_disconnect(void)
{
	(void)close(client_fd);
}

static int server_init(void)
{
	struct sockaddr_in *server4 = ((struct sockaddr_in *)&host_addr);

	server4->sin_family = AF_INET;
	server4->sin_port = htons(CONFIG_UDP_SERVER_PORT);

	inet_pton(AF_INET, CONFIG_UDP_SERVER_ADDRESS_STATIC,
		  &server4->sin_addr);

	return 0;
}

static int server_connect(void)
{
	int err;
#if defined(CONFIG_TEST_USE_TCP)
	client_fd = socket(AF_INET, SOCK_STREAM /* SOCK_DGRAM */, IPPROTO_TCP /* IPPROTO_UDP*/);
#else
	client_fd = socket(AF_INET,  SOCK_DGRAM , IPPROTO_UDP);
#endif
	if (client_fd < 0) {
		printk("Failed to create UDP socket: %d\n", errno);
		goto error;
	}
#if defined(CONFIG_UDP_RECV_TIMEOUT_SECONDS)
	struct timeval timeout = {
		.tv_sec = CONFIG_UDP_RECV_TIMEOUT_SECONDS,
		.tv_usec = 0,
	};

	err = setsockopt(client_fd,
			 SOL_SOCKET,
			 SO_RCVTIMEO,
			 &timeout,
			 sizeof(timeout));
	if (err) {
		printk("Failed to setup socket timeout, errno %d\n", errno);
		/* do not return */ /* return -1; */
	}
#endif
	err = connect(client_fd, (struct sockaddr *)&host_addr,
		      sizeof(struct sockaddr_in));
	if (err < 0) {
		printk("Connect failed : %d\n", errno);
		goto error;
	}

	return 0;

error:
	server_disconnect();

	return err;
}

/*  setup CEREG=5 for URC, only require this fun call if CFUN=0 used to switch modem off */
int lte_lc_cereg_setup_onoff(void)
{
	if (at_cmd_write("AT+CEREG=5", NULL, 0, NULL) != 0) {
		return -EIO;
	}
	return 0;
}


static void server_transmission_work_fn(struct k_work *work)
{
	int err;
    static uint32_t cnt;
    int32_t packets_to_send = CONFIG_UDP_DATA_UPLOAD_SIZE_BYTES;

	char buffer[CONFIG_UDP_DATA_UPLOAD_SIZE_BYTES + 8] = {"#"}; /* reserve data at the end of the buffer */

    memset(buffer, '#', CONFIG_UDP_DATA_UPLOAD_SIZE_BYTES);
    buffer[CONFIG_UDP_DATA_UPLOAD_SIZE_BYTES-1] = '*';
    buffer[CONFIG_UDP_DATA_UPLOAD_SIZE_BYTES-2] = '*';
#if defined(CONFIG_RECEIVE_UDP_PACKETS)
    cnt=0;
    sprintf(buffer, "pkg:%d ", cnt);  /* fixed packets for server to check and reply.  */
#else
    sprintf(buffer, "pkg:%d ", cnt++);
#endif
    

#if defined(CONFIG_UDP_ON_OFF_ENABLE) 

#if defined(CONFIG_BSD_LIBRARY)
    lte_lc_connect_async_onoff(lte_handler);
	k_sem_take(&lte_connected, K_FOREVER);
#endif
	err = server_init();
	if (err) {
		printk("Not able to initialize UDP server connection\n");
        goto workerror;
		/* return; */ /* do not return */
	}
	err = server_connect();
	if (err) {
		printk("Not able to connect to UDP server\n");
        goto workerror;
		/* return; */ /* do not return */
	}
#endif
	printk("Transmitting UDP/IP payload of %d bytes to the ",
	       CONFIG_UDP_DATA_UPLOAD_SIZE_BYTES + UDP_IP_HEADER_SIZE);
	printk("IP address %s, port number %d\n",
	       CONFIG_UDP_SERVER_ADDRESS_STATIC, CONFIG_UDP_SERVER_PORT);
    

    int32_t pkg_sent = 0;
    while( packets_to_send > 0)
    {   
        int32_t pkg_out = ((packets_to_send > EACH_MAX_TCP_PACKET)? EACH_MAX_TCP_PACKET: packets_to_send);
        err = send(client_fd, &buffer[pkg_sent], pkg_out, 0);
        printk("package send :%d\n", err);
        if (err < 0) {
            printk("Failed to transmit UDP packet, %d\n", errno);
            goto workerror;
            /* return; */ /* do not return */
        } 
        pkg_sent += pkg_out;
        packets_to_send = packets_to_send - pkg_out;
    }

#if defined(CONFIG_RECEIVE_UDP_PACKETS)

    memset(buffer, 0, sizeof(buffer));

	err = recv(client_fd, buffer, CONFIG_UDP_DATA_UPLOAD_SIZE_BYTES, 0);
	if (err < 0) {
		printk("Failed to receive UDP packet, %d\n", errno);
        goto workerror;
		/* return; */ /* do not return */
	}  
    printk("recv: %s\n", buffer);

#endif

workerror:

    server_disconnect();
#if defined(CONFIG_UDP_ON_OFF_ENABLE) 

#if defined(CONFIG_USE_CFUN_0_OFF)
	lte_lc_power_off(); 
#else
	lte_lc_offline();
#endif
     
#endif 
    

#if defined(CONFIG_USE_CFUN_0_OFF)	
    lte_lc_cereg_setup_onoff();   /**/   /* Have to enable this line if use CFUN=0 instead of CFUN=4.  */
#endif
	k_delayed_work_submit(
		&server_transmission_work,
		K_SECONDS(CONFIG_UDP_DATA_UPLOAD_FREQUENCY_SECONDS));
}

static void work_init(void)
{
	k_delayed_work_init(&server_transmission_work,
			    server_transmission_work_fn);
}
void disable_uart() /* disable UART to measure current. use this one if CONFIG_SERIAL=n doens't work */
{
	NRF_UARTE0->ENABLE = 0;
	NRF_UARTE1->ENABLE = 0;
}

void main(void)
{
	printk("UDP sample has started\n");

	work_init();

#if defined(CONFIG_UDP_ON_OFF_ENABLE) 
    modem_configure_onoff();
#endif
	k_delayed_work_submit(&server_transmission_work, K_NO_WAIT);

	/* no need for now,  disable UART here to save power */
	/*  disable_uart();  */ 
}
```
