## CMakeLists.txt
```
# SPDX-License-Identifier: Apache-2.0

cmake_minimum_required(VERSION 3.13.1)

find_package(Zephyr REQUIRED HINTS $ENV{ZEPHYR_BASE})
project(hello_world)

target_sources(app PRIVATE src/main.c)
zephyr_linker_sources_ifdef(CONFIG_FW_INFO
  ROM_START
  #SORT_KEY 0x400  # not used for now. 
  custom_flash.ld)
```

## prj.conf
```kconfig
# nothing here

CONFIG_SECURE_BOOT=y
CONFIG_BUILD_S1_VARIANT=y
CONFIG_FW_INFO_FIRMWARE_VERSION=1

#use custom signature key file. 
CONFIG_SB_SIGNING_KEY_FILE="leo_priv.pem"
CONFIG_SB_PUBLIC_KEY_FILES="leo_pub.pem"
```

## src/main.c
```c
/*
 * Copyright (c) 2012-2014 Wind River Systems, Inc.
 *
 * SPDX-License-Identifier: Apache-2.0
 */

#include <zephyr.h>
#include <sys/printk.h>

/* Jut a example: this static data will be placed in the specified flash, after the firmware info.   */
Z_GENERIC_SECTION(.custom_flash_vars) __attribute__((used))
const uint8_t g_var[] = {0x55, 0xaa, 0x55, 0xaa};

void main(void)
{

	printk("Hello World! %s\n", CONFIG_BOARD);
}
```
