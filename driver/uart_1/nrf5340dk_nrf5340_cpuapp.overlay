&uart1 {
	compatible = "nordic,nrf-uarte";
	status = "okay";
	label = "UART_1";
	current-speed = < 0x1c200 >;
	tx-pin = < 0x14 >;
	rx-pin = < 0x16 >;
	rts-pin = < 0x13 >;
	cts-pin = < 0x15 >;
};

&uart0 {
	status = "disabled";
	label = "UART_0";
	compatible = "nordic,nrf-uarte";
    current-speed = < 0x1c200 >;

	tx-pin = < 0x14 >;
	rx-pin = < 0x16 >;
	rts-pin = < 0x13 >;
	cts-pin = < 0x15 >;

};
